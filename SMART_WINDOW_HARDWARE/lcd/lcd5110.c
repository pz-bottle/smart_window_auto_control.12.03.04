#include "lcd5110.h"
// 数值库
u8 numlib[]="0123456789";  
// 字符库6*8 列行式
const u8 font[][6] =
{
	{ 0x00, 0x00, 0x00, 0x00, 0x00, 0x00 },   // sp
	{ 0x00, 0x00, 0x00, 0x2f, 0x00, 0x00 },   // !
	{ 0x00, 0x00, 0x07, 0x00, 0x07, 0x00 },   // "
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	{ 0x00, 0x20, 0x10, 0x08, 0x04, 0x02 },   // /

/* 字符0编码开始处 */{ 0x00, 0x3E, 0x51, 0x49, 0x45, 0x3E },   // 0
	{ 0x00, 0x00, 0x42, 0x7F, 0x40, 0x00 },   // 1
	{ 0x00, 0x42, 0x61, 0x51, 0x49, 0x46 },   // 2
	{ 0x00, 0x21, 0x41, 0x45, 0x4B, 0x31 },   // 3
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	{ 0x14, 0x14, 0x14, 0x14, 0x14, 0x14 }    // horiz lines
};

void LcdIoInit(void)
{
	GPIO_InitTypeDef GPIO_InitStructure; 
	RCC_APB2PeriphClockCmd(RCC_APB2Periph_GPIOE, ENABLE);
	RCC_APB2PeriphClockCmd(RCC_APB2Periph_GPIOD, ENABLE);

	GPIO_InitStructure.GPIO_Pin=  \
	GPIO_Pin_9 | GPIO_Pin_11 | GPIO_Pin_13|GPIO_Pin_15; 
	GPIO_InitStructure.GPIO_Mode = GPIO_Mode_Out_PP;   
	GPIO_InitStructure.GPIO_Speed = GPIO_Speed_50MHz; 
	GPIO_Init(GPIOE, &GPIO_InitStructure); 
	
	GPIO_InitStructure.GPIO_Pin=  \
	GPIO_Pin_0 | GPIO_Pin_9 ; 
	GPIO_Init(GPIOD, &GPIO_InitStructure); 
	//打开背光灯
	BL_L;
}
static void __LcdInit(void)
{
	//产生一个让LCD复位的低电平脉冲
	RST_L;
  	RST_H;
	LcdWriteByte(0x21, 0); // 使用扩展命令设置LCD模式     
	LcdWriteByte(0xc8, 0); // 设置液晶偏置电压     
	LcdWriteByte(0x06, 0); // 温度校正     
	LcdWriteByte(0x13, 0); // 1:48      
	LcdWriteByte(0x20, 0); // 使用基本命令，V=0，水平寻址     
	LcdWriteByte(0x0c, 0); // 设定显示模式，正常显示
}
void LcdReset(void)
{
	__LcdInit();
}
void LcdInit(void)
{
    LcdIoInit();
    __LcdInit();
    LcdClear();            // 清屏      

}
void LcdWriteByte(u8 data, u8 cmd)
{
	u8 i; 
	CE_L;//使能LCD           
	if(cmd==0)            
    //传送命令
	DC_L;
	else
    //传送数据
    DC_H;         
	for(i=0;i<8;i++)
	{
		SCK_L;	
		delay_us(1);
		if((data&0x80)>>7)
		{
			DIN_H;
			delay_us(1);
		}
		else
		{
			DIN_L;
			delay_us(1);
		}
		data=data<<1;
		SCK_H;	
		delay_us(1);
	}
    //失能LCD
    CE_H;
}
void LcdSetXY(u8 X, u8 Y)
{
    //0<=X<=83
    //0<=Y<=5
    if(Y>5 )Y=5;
    if(X>83)X=83;
    Y|=0x40;
    X|=0x80;
	LcdWriteByte(Y, 0);// 列
	LcdWriteByte(X, 0);// 行
} 
void LcdClear(void)
{
	u8 t,k;
	LcdSetXY(0,0);
	for(t=0;t<6;t++)
	{
		for(k=0;k<84;k++)
		{ 
			LcdWriteByte(0x00,1);
		} 
	}
}
void LcdWriteChar(u8 X,u8 Y,u8 c)
{
    u8 i,j ;
    const  u8 *map = &font[0][0];
    c -= 32; //为什么减32？减去32正好是字符的ascci编码的值减32等于字符的显示编码在编码库(即数组font)的起始位置
    map += c *( HEIGHT/8*WIDTH);// 找到目标字符编码的开始处，例如找‘0’则'0'-32=16,16*6='0'开始的地方
															// 找‘A’则'A'-32=33,33*6='A'开始的地方
															// 找‘!’则'!'-32=1 ,1*6 ='!'开始的地方
	
	// 不建库也是可以的，但是有了库就可以直接传目标字符，所见即所得，优势明显
    for(i=0;i<HEIGHT/8;i++)
    {
        LcdSetXY(X, Y+i);
        for(j=0;j<WIDTH;j++)//上到下（8点），左到右画点（6点）
        {
            //保证不越界
            if(X+j>83)return;
            LcdWriteByte(*map++, 1);
        }
    }
}
void LcdWriteString(u8 X,u8 Y,u8 *s)
{
    u8 i=0;//,j=0;
    while (*s)
    {
        LcdWriteChar(X, Y,*s++);
        X+=WIDTH;//跳到下一列
        i++;
	if(i>=84/WIDTH) 
		return;
#if 0//不支持自动换行    
        if(i>=(84/WIDTH))// 一行有 84/WIDTH 个位置
		{// 换行写
			X=0;
			Y+=HEIGHT;//跳到下一行
			i=0;
			j++;
		}
		if(j>=(48/HEIGHT))// 一列共有48/HEIGHT个位置
		{// 写满了
		 return  ;
		}
#endif		
    }
 } 

void LcdWriteNumber(u8 x,u8 y, unsigned long number)
{
    u8 num[10]={""},i,j,k;
    if(number==0)                   //number 0 时候
    {
        LcdWriteChar(x, y,'0');
    }
    else
    {     
        for(i=0;number>0;i++)
        {
            num[i]=numlib[number%10];//数值到数值字符的转换
            number/=10; 
        }
        for(j=0;j<i/2;j++)
        {// 调整字符的位置
            k=num[j];
            num[j]=num[i-1-j];
            num[i-1-j]=k;
        }
            LcdWriteString(x,y,num);
    }
}

void LcdMoveCharRight(u8 Y,u8 *s)
{// 实现右移动
    static u16 x,x2;
    x+=1;//移动步长
    x2=x;
    while (*s!=0)
    {        
        LcdWriteChar(x%84, Y,*s++);
        x+=WIDTH;
    }
	x=x2;
}
void LcdMoveCharLeft(u8 Y,u8 *s)
{// 实现左移动
    static u16 x,x2;
    x-=1;//移动步长
    x2=x;
    while (*s)
    {
        LcdWriteChar(x%84, Y,*s++);
        x+=WIDTH;
	}
	x=x2;
}

void LcdMoveUpToDowm(u8 x,u8 *s)
{
    static u8 y;
    u8 y2;
    y+=1;
    y2=y;
    LcdShowChineseUpToDown(0,y2,10,1,8,s);
}

//左到右显示汉字
void LcdShowChineseLeftToRight(u8 x,u8 y,u8 c,u8 h,u8 w,u8 chineseString[])
{  					
    //阴码1亮0灭列行式逆向取模即上到下，左到右，先低字节
    //c：汉字的个数
    //h：一个汉字所占的像素行数除8
    //w：一个汉字所占的像素列数
    u8 i,j,k;
    //u8 c,h,w;
//    c=3;
//    h=2;
//    w=16;

    //i行j列
    for(k=0;k<c;k++)
    {
        for(i=0;i<h;i++)
        {
            for(j=0;j<w;j++)
            {
                LcdSetXY(j+k*w+x,i+y);
                
                LcdWriteByte(chineseString[j+i*w+k*w*h],1);
            }
        }
    }
}   

//上到下显示汉字
void LcdShowChineseUpToDown(u8 x,u8 y,u8 c,u8 h,u8 w,u8 chineseString[])
{  					
    //阴码1亮0灭列行式逆向取模即上到下，左到右，先低字节
    //c：汉字的个数
    //h：一个汉字所占的像素行数除8
    //w：一个汉字所占的像素列数
    u8 i,j,k;
    //u8 c,h,w;
//    c=3;
//    h=2;
//    w=16;

    //i行j列
    for(k=0;k<c;k++)
    {
        for(i=0;i<h;i++)
        {
            for(j=0;j<w;j++)
            {
                LcdSetXY(j+x,i+k*h+y);
                
                LcdWriteByte(chineseString[j+i*w+k*w*h],1);
            }
        }
    }
}




